## CMakeLists.txt
```
cmake_minimum_required(VERSION 3.13.1)

set(BOARD_ROOT ${CMAKE_CURRENT_SOURCE_DIR}/.)

if(NOT DEFINED BOARD)
    set(BOARD "nrf52840dk/nrf52840")
endif()

set(BOARD_FLASH_RUNNER openocd)

find_package(Zephyr REQUIRED HINTS $ENV{ZEPHYR_BASE})
project(zephyr-linux-ble-copro)

set(app_sources
    src/main.c
    src/ble_observer.c
)

target_sources_ifdef(CONFIG_COPRO_USB_NETWORK app PRIVATE src/usb_net.c)
target_sources_ifdef(CONFIG_COPRO_STREAM_CLIENT app PRIVATE src/stream_client.c)
target_sources_ifdef(CONFIG_COPRO_DEVICE_CONTROL app PRIVATE src/device_control.c)
target_sources_ifdef(CONFIG_COPRO_XIAOMI_LYWSD03MMC app PRIVATE src/xiaomi.c)
target_sources_ifdef(CONFIG_COPRO_LINKY_TIC app PRIVATE src/linky.c)
target_sources_ifdef(CONFIG_COPRO_LED app PRIVATE src/led.c)
target_sources_ifdef(CONFIG_COPRO_BLE_SERVER app PRIVATE src/ble_server.c)
target_sources_ifdef(CONFIG_COPRO_BUTTON app PRIVATE src/button.c)

target_include_directories(app PRIVATE include)
target_sources(app PRIVATE ${app_sources})
```

## Kconfig
```
config COPRO_LED
    bool "LED Configuration"
    default y
    help
      This option allows you to use the LED.

config COPRO_DFU
    bool "DFU trigger support"
    depends on BOOTLOADER_MCUBOOT
    depends on RETENTION_BOOT_MODE
    depends on IMG_MANAGER
    default y if BOOTLOADER_MCUBOOT
    help
      Enables the DFU trigger module. When called, it sets the boot mode
      to BOOTLOADER via the retention subsystem and reboots into MCUboot
      serial recovery mode. Also confirms the current image on startup so
      MCUboot does not revert it.

menuconfig COPRO_BUTTON
    bool "Button support"
    default n
    help
      Enable support for the board button referenced by the devicetree
      alias sw0.

menuconfig COPRO_USB_NETWORK
    bool "USB Network Configuration"
    default y
    depends on USB_DEVICE_NETWORK_ECM
    help
      This option allows you to configure the USB network settings.

if COPRO_USB_NETWORK

config COPRO_USB_ECM_IPV4_ADDR
    string "IPv4 Address"
    default "192.0.3.2"
    depends on USB_DEVICE_NETWORK_ECM
    help
      The IPv4 address to assign to the USB Ethernet Control Model (ECM) interface.

config COPRO_USB_ECM_IPV4_GW
    string "IPv4 Gateway"
    default "192.0.3.1"
    depends on USB_DEVICE_NETWORK_ECM
    help
      The IPv4 gateway to assign to the USB Ethernet Control Model (ECM) interface.

config COPRO_USB_ECM_IPV4_NETMASK
    string "IPv4 Netmask"
    default "255.255.255.0"
    depends on USB_DEVICE_NETWORK_ECM
    help
      The IPv4 netmask to assign to the USB Ethernet Control Model (ECM) interface.

endif # COPRO_USB_NETWORK

menuconfig COPRO_XIAOMI_LYWSD03MMC
    bool "Xiaomi LYWSD03MMC support"
    default y
    help
      This option allows you to report the measurements from the Xiaomi LYWSD03MMC sensor.

if COPRO_XIAOMI_LYWSD03MMC

config COPRO_XIAOMI_QUEUE_SIZE
    int "Queue Size"
    default 20
    help
      The size of the queue to store the measurements from the Xiaomi LYWSD03MMC sensor.

endif # COPRO_XIAOMI_LYWSD03MMC

menuconfig COPRO_LINKY_TIC
    bool "Linky Meter support"
    default y
    help
      This option allows you to report the measurements from the Linky meter.

if COPRO_LINKY_TIC

config COPRO_LINKY_TIC_COMPLETE_NAME
    string "Complete Name of the Linky Meter TIC Device"
    default "Linky TIC"
    help
      The complete name of the Linky Meter TIC device to scan for.

config COPRO_LINKY_QUEUE_SIZE
    int "Queue Size"
    default 20
    help
      The size of the queue to store the measurements from the Linky meter.

endif # COPRO_LINKY_TIC

menuconfig COPRO_STREAM_CLIENT
    bool "Coprocessor stream Client"
    default y
    depends on USB_DEVICE_NETWORK_ECM
    help
      This option allows you to configure the Stream Client settings.

if COPRO_STREAM_CLIENT

config COPRO_STREAM_PORT
    int "Stream Port"
    default 4000
    help
      The port number to use for the Stream Client.

config COPRO_STREAM_HOST
    string "Stream Host"
    default "192.0.3.1"
    help
      The host to connect to for the Stream Client.

config COPRO_STREAM_TRY_CONNECT_INTERVAL
    int "Stream Try Connect Interval"
    default 1000
    help
      The interval in milliseconds to try to connect to the Stream Client.

config COPRO_STREAM_CHANNELS_COUNT
    int "Stream Channels Count"
    default 2 if COPRO_XIAOMI_LYWSD03MMC && COPRO_LINKY_TIC
    default 1
    help
      The number of channels to use for the Streams.

config COPRO_STREAM_CHANNEL_MSG_MAX_SIZE
    int "Stream Channel (SC) Message Max Size"
    default 128
    help
      The maximum size of the message to send to the Stream Client.

config COPRO_STREAM_CHANNEL_RX
    bool "Enable RX (server-to-device) channel support"
    default n
    help
      When enabled, a dedicated RX thread is started. It reads incoming
      frames from the server and dispatches each payload to the rx_msgq
      of the matching channel (if one was registered). Disable this to
      reduce flash and RAM when bidirectional communication is not needed.

endif # COPRO_STREAM_CLIENT

menuconfig COPRO_DEVICE_CONTROL
    bool "Device Control channel"
    default n
    depends on COPRO_STREAM_CLIENT
    select COPRO_STREAM_CHANNEL_RX
    help
      Enables the device-control stream channel.  Commands (e.g. open
      garage door) are sent from the device to the server, and state
      updates (e.g. garage-door positions) are received from the server.

if COPRO_DEVICE_CONTROL

config COPRO_DEVICE_CONTROL_CMD_QUEUE_SIZE
    int "Command queue size"
    default 8
    help
      Number of outgoing command messages that can be buffered before the
      TX thread drains them.

config COPRO_DEVICE_CONTROL_STATE_QUEUE_SIZE
    int "State queue size"
    default 8
    help
      Number of incoming state messages that can be buffered before the
      application reads them.

endif # COPRO_DEVICE_CONTROL

menuconfig COPRO_CONFIG_SERVER
    bool "Coprocessor configuration server"
    default n
    depends on USB_DEVICE_NETWORK_ECM
    help
      This option allows you to configure the Configuration Server settings.

if COPRO_CONFIG_SERVER

config COPRO_CONFIG_PORT
    int "Configuration Port"
    default 4001
    help
      The port number to use for the Configuration Server.

endif # COPRO_CONFIG_SERVER

menuconfig COPRO_BLE_SERVER
    bool "Coprocessor BLE Server"
    default n
    help
      This option allows you to expose services from the coprocessor as a BLE server.

if COPRO_BLE_SERVER

config COPRO_BLE_IDLE_TIMEOUT_S
    int "BLE idle connection timeout (seconds)"
    default 30
    help
      Disconnect a BLE connection that has been idle for this many seconds.
      Idle means no authenticated GATT write or security-level upgrade has
      been received. Set to 0 to disable the timeout entirely.

endif # COPRO_BLE_SERVER

menu "Zephyr RTOS Configuration"

source "Kconfig.zephyr"

endmenu
```

## west.yml
```
# Copyright (c) 2020 Lucas Dietrich (ld.adecy@gmail.com)
# SPDX-License-Identifier: Apache-2.0

manifest:
  self:
    path: zephyr-linux-ble-copro

  remotes:
    - name: zephyrproject-rtos
      url-base: https://github.com/zephyrproject-rtos
    - name: zephyrproject-rtos-fork
      url-base: https://github.com/lucasdietrich

  projects:
    - name: zephyr
      remote: zephyrproject-rtos
      revision: v4.4.2
      import: true
```

## prj.conf
```kconfig
CONFIG_KERNEL_BIN_NAME="ble-copro"

CONFIG_PRINTK=y

CONFIG_THREAD_NAME=y
CONFIG_INIT_STACKS=y
CONFIG_THREAD_STACK_INFO=y
CONFIG_MPU_STACK_GUARD=y

CONFIG_MAIN_STACK_SIZE=4096
CONFIG_SYSTEM_WORKQUEUE_STACK_SIZE=2048

CONFIG_BT=y
CONFIG_BT_OBSERVER=y
CONFIG_BT_PERIPHERAL=y
CONFIG_BT_DEVICE_NAME="HA Copro"

# security/pairing
CONFIG_BT_SMP=y
CONFIG_BT_MAX_PAIRED=5
CONFIG_BT_MAX_CONN=5

CONFIG_BT_FILTER_ACCEPT_LIST=y
CONFIG_BT_PRIVACY=y

CONFIG_SETTINGS=y
CONFIG_BT_SETTINGS=y
CONFIG_FLASH=y
CONFIG_FLASH_PAGE_LAYOUT=y
CONFIG_FLASH_MAP=y
CONFIG_NVS=y

CONFIG_DEPRECATION_TEST=y
CONFIG_USB_DEVICE_STACK_NEXT=n
CONFIG_USB_DEVICE_STACK=y
CONFIG_USB_DEVICE_NETWORK_ECM=y
CONFIG_USB_DEVICE_NETWORK_ECM_MAC="00005E005301"

CONFIG_USB_DEVICE_MANUFACTURER="HA Copro"
CONFIG_USB_DEVICE_PRODUCT="BLE Linux Copro"
CONFIG_USB_DEVICE_VID=0x2FE3
CONFIG_USB_DEVICE_PID=0x0100

CONFIG_USB_DRIVER_LOG_LEVEL_INF=y
CONFIG_USB_DEVICE_LOG_LEVEL_INF=y

CONFIG_NETWORKING=y
CONFIG_NET_IPV4=y
CONFIG_NET_TCP=y
CONFIG_NET_SOCKETS=y
CONFIG_POSIX_API=y

CONFIG_NET_TCP_TIME_WAIT_DELAY=0

CONFIG_NET_MGMT=y
CONFIG_NET_MGMT_EVENT=y
CONFIG_NET_MGMT_EVENT_LOG_LEVEL_INF=y

CONFIG_NET_LOG=y

CONFIG_COPRO_STREAM_CHANNELS_COUNT=4

CONFIG_COPRO_DEVICE_CONTROL=y
CONFIG_COPRO_DEVICE_CONTROL_CMD_QUEUE_SIZE=8
CONFIG_COPRO_DEVICE_CONTROL_STATE_QUEUE_SIZE=8

CONFIG_COPRO_BLE_SERVER=y
CONFIG_COPRO_XIAOMI_LYWSD03MMC=y
CONFIG_COPRO_LINKY_TIC=y
```

## boards/nrf52840dk_nrf52840.overlay
```dts
/*
 * Application overlay for nrf52840dk/nrf52840
 *
 * Expose the GPREGRET1 retention node as zephyr,boot-mode so the
 * application can signal MCUboot to enter serial recovery mode.
 */

/ {
	chosen {
		zephyr,boot-mode = &boot_mode0;
	};
};
```

## src/main.c
```c
/*
 * Copyright (c) 2024 Lucas Dietrich <ld.adecy@gmail.com>
 *
 * SPDX-License-Identifier: Apache-2.0
 */

#include "ble_server.h"

#include <complex.h>

#include <zephyr/app_version.h>
#include <zephyr/bluetooth/bluetooth.h>
#include <zephyr/kernel.h>
#include <zephyr/logging/log.h>
#include <zephyr/settings/settings.h>
#include <zephyr/usb/usb_device.h>

#include <ble_observer.h>
#include <button.h>
#include <device_control.h>
#include <led.h>
#include <linky.h>
#include <stream_client.h>
#include <usb_net.h>
#include <xiaomi.h>

LOG_MODULE_REGISTER(ble, LOG_LEVEL_INF);

int main(void)
{
	int ret;

	printf("\nStarting BLE Co-Processor firmware %s\n", APP_VERSION_STRING);

#if CONFIG_COPRO_LED
	/* Led initialization */
	ret = board_led_init();
	if (ret != 0) {
		LOG_ERR("Failed to initialize LED (ret %d)", ret);
		return ret;
	}
#endif

#if CONFIG_COPRO_BUTTON
	ret = board_button_init();
	if (ret != 0) {
		LOG_ERR("Failed to initialize button (ret %d)", ret);
		return ret;
	}
#endif

#if CONFIG_COPRO_USB_NETWORK
	/* Initialize NET interface management */
	usb_net_iface_init();
#endif

#if !CONFIG_USB_DEVICE_INITIALIZE_AT_BOOT
	/* Initialize the USB Subsystem */
	ret = usb_enable(NULL);
	if (ret != 0) {
		LOG_ERR("Failed to enable USB (ret %d)", ret);
		return ret;
	}

	LOG_INF("USB initialized %d", 0);
#endif

	/* Initialize the Bluetooth Subsystem */
	ret = bt_enable(NULL);
	if (ret != 0) {
		LOG_ERR("Bluetooth init failed (ret %d)", ret);
		return ret;
	}

	ret = settings_load();
	if (ret != 0) {
		LOG_ERR("Failed to load settings (ret %d)", ret);
		return ret;
	}

	LOG_INF("Bluetooth initialized %d", 0);

	/* Start the BLE observer thread */
	ble_observer_start();

#if CONFIG_COPRO_BLE_SERVER
	ret = ble_server_start();
	if (ret != 0) {
		LOG_ERR("Failed to start BLE server (ret %d)", ret);
		return ret;
	}
#endif

#if CONFIG_COPRO_XIAOMI_LYWSD03MMC
	/* Configure the stream client */
	ret = stream_client_channel_add(SC_ID_XIAOMI, SC_NAME_XIAOMI, &xiaomi_msgq, NULL);
	if (ret < 0) {
		LOG_ERR("Failed to add xiaomi channel to stream client: %d", ret);
		return ret;
	}
#endif /* CONFIG_COPRO_XIAOMI_LYWSD03MMC */

#if CONFIG_COPRO_LINKY_TIC
	/* Configure the stream client */
	ret =
		stream_client_channel_add(SC_ID_LINKY_TIC, SC_NAME_LINKY_TIC, &linky_msgq, NULL);
	if (ret < 0) {
		LOG_ERR("Failed to add linky channel to stream client: %d", ret);
		return ret;
	}
#endif /* CONFIG_COPRO_LINKY_TIC */

#if CONFIG_COPRO_DEVICE_CONTROL
	ret = stream_client_channel_add(SC_ID_DEVICE_CONTROL,
									SC_NAME_DEVICE_CONTROL,
									&device_control_tx_msgq,
									&device_control_rx_msgq);
	if (ret < 0) {
		LOG_ERR("Failed to register device-control channel: %d", ret);
		return ret;
	}

	device_control_start();
#endif /* CONFIG_COPRO_DEVICE_CONTROL */

	/* Start the stream client after all channels have been added */
	stream_client_start();

	return 0;
}
```

## include/ble_observer.h
```c
/*
 * Copyright (c) 2024 Lucas Dietrich <ld.adecy@gmail.com>
 *
 * SPDX-License-Identifier: Apache-2.0
 */

#ifndef _BLE_OBSERVER_H
#define _BLE_OBSERVER_H

#include <stdint.h>

#include <zephyr/bluetooth/addr.h>

int ble_observer_start(void);

#endif /* _BLE_OBSERVER_H */
```

## include/ble_server.h
```c
/*
 * Copyright (c) 2026 Lucas Dietrich <ld.adecy@gmail.com>
 *
 * SPDX-License-Identifier: Apache-2.0
 */

#ifndef _BLE_SERVER_H
#define _BLE_SERVER_H

#include <stdint.h>

#include <zephyr/bluetooth/addr.h>

/* ---------------------------------------------------------------------------
 * Garage Control Service
 *
 * Attribute layout:
 *  0  – primary service declaration
 *  1  – left door characteristic declaration
 *  2  – left door characteristic value       ← indicate target
 *  3  – left door CCC descriptor
 *  4  – right door characteristic declaration
 *  5  – right door characteristic value      ← indicate target
 *  6  – right door CCC descriptor
 *  7  – gate characteristic declaration
 *  8  – gate characteristic value            ← indicate target
 *  9  – gate CCC descriptor
 *  10 – firmware flags characteristic declaration
 *  11 – firmware flags characteristic value  ← notify target
 *  12 – firmware flags CCC descriptor
 * ---------------------------------------------------------------------------*/

#define BT_UUID_GARAGE_SERVICE_VAL                                                       \
	BT_UUID_128_ENCODE(0x539f0000, 0x43b5, 0x4c29, 0x9ea2, 0x99a56589ca60)
#define BT_UUID_GARAGE_LEFT_DOOR_VAL                                                     \
	BT_UUID_128_ENCODE(0x539f0001, 0x43b5, 0x4c29, 0x9ea2, 0x99a56589ca60)
#define BT_UUID_GARAGE_RIGHT_DOOR_VAL                                                    \
	BT_UUID_128_ENCODE(0x539f0002, 0x43b5, 0x4c29, 0x9ea2, 0x99a56589ca60)
#define BT_UUID_GARAGE_GATE_VAL                                                          \
	BT_UUID_128_ENCODE(0x539f0003, 0x43b5, 0x4c29, 0x9ea2, 0x99a56589ca60)
#define BT_UUID_GARAGE_FLAGS_VAL                                                         \
	BT_UUID_128_ENCODE(0x539f0004, 0x43b5, 0x4c29, 0x9ea2, 0x99a56589ca60)

#define BT_UUID_GARAGE_SERVICE	  BT_UUID_DECLARE_128(BT_UUID_GARAGE_SERVICE_VAL)
#define BT_UUID_GARAGE_LEFT_DOOR  BT_UUID_DECLARE_128(BT_UUID_GARAGE_LEFT_DOOR_VAL)
#define BT_UUID_GARAGE_RIGHT_DOOR BT_UUID_DECLARE_128(BT_UUID_GARAGE_RIGHT_DOOR_VAL)
#define BT_UUID_GARAGE_GATE		  BT_UUID_DECLARE_128(BT_UUID_GARAGE_GATE_VAL)
#define BT_UUID_GARAGE_FLAGS	  BT_UUID_DECLARE_128(BT_UUID_GARAGE_FLAGS_VAL)

/* Firmware status flags bit definitions (firmware flags characteristic) */
#define BLE_FLAG_SERVER_CONNECTED BIT(0) /**< bit 0: TCP stream server is connected */

int ble_server_start(void);

typedef enum {
	BLE_CTRL_EVENT_CONNECTED		   = 0x01,
	BLE_CTRL_EVENT_DISCONNECTED		   = 0x02,
	BLE_CTRL_EVENT_PAIRING_CODE		   = 0x03,
	BLE_CTRL_EVENT_PAIRING_RESULT	   = 0x04,
	BLE_CTRL_EVENT_ALL_BONDS_REMOVED   = 0x05,
	BLE_CTRL_EVENT_IDENTITY_RESOLVED   = 0x06,
	BLE_CTRL_EVENT_PAIRING_ADV_STARTED = 0x07, /**< pairing advertising window opened */
	BLE_CTRL_EVENT_PAIRING_ADV_STOPPED = 0x08, /**< pairing advertising window closed */
} ble_ctrl_event_t;

/* RX actions (server → device) */
#define BLE_CTRL_ACTION_REMOVE_ALL_BONDS 0xFFFFFFFFu
#define BLE_CTRL_ACTION_REMOVE_BOND		 0xFFFFFFFEu
#define BLE_CTRL_ACTION_ENABLE_PAIRING_ADV                                               \
	0xFFFFFFFDu /**< open a pairing advertising window; param: duration_s */

struct ble_ctrl_pairing_code {
	uint32_t passkey; /* 6-digit numeric code */
};

struct ble_ctrl_pairing_result {
	uint32_t success; // 0 for success, non-zero for failure (e.g. cancelled by user)
};

struct ble_ctrl_identity_resolved {
	bt_addr_le_t rpa;
	bt_addr_le_t identity;
};

struct ble_ctrl_pairing_adv_started {
	uint32_t duration_s; /**< advertising window duration in seconds */
};

struct ble_ctrl_tx_msg {
	uint32_t cmd;
	bt_addr_le_t addr;
	union {
		struct ble_ctrl_pairing_code pairing_code;
		struct ble_ctrl_pairing_result pairing_result;
		struct ble_ctrl_identity_resolved identity_resolved;
		struct ble_ctrl_pairing_adv_started pairing_adv_started;
	} param;
};

struct ble_ctrl_pairing_adv_params {
	uint32_t duration_s; /**< advertising window duration in seconds */
};

struct ble_ctrl_rx_msg {
	uint32_t action;
	union {
		bt_addr_le_t addr; /**< REMOVE_BOND: target address */
		struct ble_ctrl_pairing_adv_params
			pairing_adv; /**< ENABLE_PAIRING_ADV: duration */
	} param;
};

#define SC_NAME_BLE_CONTROL "ble-control"
#define SC_ID_BLE_CONTROL	0x4f154ca0

#define SC_TX_PAYLOAD_SIZE_BLE_CONTROL	 sizeof(struct ble_ctrl_tx_msg)
#define SC_TX_MSG_QUEUE_SIZE_BLE_CONTROL 4u

#define SC_RX_PAYLOAD_SIZE_BLE_CONTROL	 sizeof(struct ble_ctrl_rx_msg)
#define SC_RX_MSG_QUEUE_SIZE_BLE_CONTROL 4u

int bt_ctrl_msg_send_pairing_code(const bt_addr_le_t *addr, uint32_t passkey);
int bt_ctrl_msg_send_pairing_result(const bt_addr_le_t *addr, bool success);
int bt_ctrl_msg_send_connected(const bt_addr_le_t *addr);
int bt_ctrl_msg_send_disconnected(const bt_addr_le_t *addr);
int bt_ctrl_msg_send_all_bonds_removed(void);
int bt_ctrl_msg_send_identity_resolved(const bt_addr_le_t *rpa,
									   const bt_addr_le_t *identity);
int bt_ctrl_msg_send_pairing_adv_started(uint32_t duration_s);
int bt_ctrl_msg_send_pairing_adv_stopped(void);

#endif /* _BLE_SERVER_H */
```

## include/button.h
```c
/*
 * Copyright (c) 2024 Lucas Dietrich <ld.adecy@gmail.com>
 *
 * SPDX-License-Identifier: Apache-2.0
 */

#ifndef _USB_BUTTON_H
#define _USB_BUTTON_H

#include <stdint.h>
#if CONFIG_COPRO_BUTTON
#define BUTTON_IS_PRESSED() board_button_is_pressed()
#else
#define BUTTON_IS_PRESSED() 0
#endif

extern bool button_pressed_flag;

int board_button_init(void);

int board_button_is_pressed(void);

#endif /* _USB_LED_H */
```

## include/device_control.h
```c
/*
 * Copyright (c) 2024 Lucas Dietrich <ld.adecy@gmail.com>
 *
 * SPDX-License-Identifier: Apache-2.0
 */

#ifndef _DEVICE_CONTROL_H
#define _DEVICE_CONTROL_H

#include <stdint.h>

#include <zephyr/bluetooth/addr.h>
#include <zephyr/kernel.h>

/* Stream channel registration */
#define SC_NAME_DEVICE_CONTROL "device-control"
#define SC_ID_DEVICE_CONTROL   0xeb5d8977

/*---------------------------------------------------------------------------
 * TX: Commands sent from device to server
 *---------------------------------------------------------------------------*/

/**
 * @brief Device control command types.
 */
typedef enum __packed {
	DEVICE_CTRL_CMD_OPEN_LEFT_GARAGE_DOOR  = 0x01,
	DEVICE_CTRL_CMD_OPEN_RIGHT_GARAGE_DOOR = 0x02,
} device_ctrl_cmd_t;

/**
 * @brief Command message transmitted over the stream channel (TX wire format).
 *
 * Wire layout:
 *   - 1 byte:  command type  (@ref device_ctrl_cmd_t)
 *   - 7 bytes: BLE address of the requesting client (1 byte address type +
 *              6 bytes MAC, little-endian — same layout as @ref bt_addr_le_t)
 */
typedef struct __packed {
	device_ctrl_cmd_t cmd;
	bt_addr_le_t ble_addr; /**< BLE address of the requesting client */
} device_ctrl_command_msg_t;

/*---------------------------------------------------------------------------
 * RX: States received from server
 *---------------------------------------------------------------------------*/

/**
 * @brief Individual door / gate position state.
 */
typedef enum __packed {
	DEVICE_CTRL_DOOR_CLOSED	 = 0x00,
	DEVICE_CTRL_DOOR_OPEN	 = 0x01,
	DEVICE_CTRL_DOOR_UNKNOWN = 0xFF,
} device_ctrl_door_state_t;

/**
 * @brief Garage doors state payload.
 *
 * Carries the live state of the left door, central gate and right door.
 */
typedef struct __packed {
	device_ctrl_door_state_t left_door;	 /**< Left garage door */
	device_ctrl_door_state_t gate;		 /**< Central gate */
	device_ctrl_door_state_t right_door; /**< Right garage door */
} device_ctrl_garage_doors_state_t;

/**
 * @brief State type tag (first byte of every RX state frame).
 */
typedef enum __packed {
	DEVICE_CTRL_STATE_TYPE_GARAGE_DOORS = 0x01,
	/* Add future state types here */
} device_ctrl_state_type_t;

/**
 * @brief Union of all possible state payloads.
 *
 * Extend this union when new state types are introduced.
 */
typedef union __packed {
	device_ctrl_garage_doors_state_t garage_doors;
	/* Future state payloads go here */
} device_ctrl_state_payload_t;

/**
 * @brief Full state message received over the stream channel (RX wire format).
 *
 * Wire layout:
 *   - 1 byte:  state type  (@ref device_ctrl_state_type_t)
 *   - N bytes: state payload (@ref device_ctrl_state_payload_t, union member
 *              selected by @p type)
 */
typedef struct __packed {
	device_ctrl_state_type_t type;
	device_ctrl_state_payload_t payload;
} device_ctrl_state_msg_t;

/*---------------------------------------------------------------------------
 * Message queues (defined in device_control.c)
 *---------------------------------------------------------------------------*/

/** TX queue – holds outgoing @ref device_ctrl_command_msg_t items. */
extern struct k_msgq device_control_tx_msgq;

/** RX queue – holds incoming @ref device_ctrl_state_msg_t items. */
extern struct k_msgq device_control_rx_msgq;

/*---------------------------------------------------------------------------
 * State update callback
 *---------------------------------------------------------------------------*/

/**
 * @brief Bitmask flags indicating which fields changed in a garage-doors
 *        state update.  Passed as @p changed to @ref device_ctrl_state_cb_t.
 */
#define DEVICE_CTRL_GARAGE_CHANGED_LEFT_DOOR  BIT(0)
#define DEVICE_CTRL_GARAGE_CHANGED_RIGHT_DOOR BIT(1)
#define DEVICE_CTRL_GARAGE_CHANGED_GATE		  BIT(2)

/**
 * @brief Callback invoked (from the RX thread) whenever the garage-doors
 *        state is updated.
 *
 * @param state   New state; valid only for the duration of the call.
 * @param changed Bitmask of @ref DEVICE_CTRL_GARAGE_CHANGED_* flags
 *                indicating which fields differ from the previous state.
 */
typedef void (*device_ctrl_state_cb_t)(const device_ctrl_garage_doors_state_t *state,
									   uint8_t changed);

/*---------------------------------------------------------------------------
 * API
 *---------------------------------------------------------------------------*/

/**
 * @brief Enqueue a command to be sent to the server.
 *
 * Thread-safe, non-blocking.  Returns -ENOMSG if the TX queue is full.
 *
 * @param cmd      Command to send.
 * @param ble_addr BLE address of the client that triggered the command.
 * @return 0 on success, negative errno on failure.
 */
int device_control_send_cmd(device_ctrl_cmd_t cmd, const bt_addr_le_t *ble_addr);

/**
 * @brief Return the most recently received garage-doors state.
 *
 * Thread-safe (protected by a spinlock).
 */
device_ctrl_garage_doors_state_t device_control_get_garage_doors_state(void);

/**
 * @brief Register a callback invoked by the RX thread on every state update.
 *
 * Only one callback is supported at a time.  Pass NULL to unregister.
 */
void device_control_set_state_cb(device_ctrl_state_cb_t cb);

/**
 * @brief Start the background RX processing thread.
 *
 * Must be called after stream_client_start().
 */
int device_control_start(void);

#endif /* _DEVICE_CONTROL_H */
```

## include/dfu.h
```c
/*
 * Copyright (c) 2024 Lucas Dietrich <ld.adecy@gmail.com>
 *
 * SPDX-License-Identifier: Apache-2.0
 */

#ifndef _DFU_H
#define _DFU_H

/**
 * @brief Confirm that the currently running firmware is good.
 *
 * Must be called once the application is considered operational.  If this is
 * not called before the next reset, MCUboot will treat the update as failed
 * and revert to the previous image.
 *
 * @return 0 on success, negative errno on failure.
 */
int dfu_confirm_image(void);

/**
 * @brief Enter MCUboot serial-recovery (DFU) mode.
 *
 * Sets the retention boot-mode flag to BOOT_MODE_TYPE_BOOTLOADER, blinks the
 * LED rapidly to signal the transition, then performs a cold reboot.
 * The MCUboot bootloader will detect the flag and enter USB CDC-ACM serial
 * recovery so the host can upload a new firmware image via mcumgr.
 *
 * This function does not return on success.
 *
 * @return Negative errno if setting the boot mode failed (function returns).
 */
int dfu_enter_bootloader(void);

#endif /* _DFU_H */
```

## include/led.h
```c
/*
 * Copyright (c) 2024 Lucas Dietrich <ld.adecy@gmail.com>
 *
 * SPDX-License-Identifier: Apache-2.0
 */

#ifndef _USB_LED_H
#define _USB_LED_H

#include <stdbool.h>
#include <stdint.h>

#if CONFIG_COPRO_LED
#define LED_ON()  board_led_on()
#define LED_OFF() board_led_off()
#else
#define LED_ON()
#define LED_OFF()
#endif

int board_led_init(void);

int board_led_on(void);

int board_led_off(void);

int board_led_set(bool on);

/**
 * @brief Start periodic LED blinking.
 *
 * @param period_ms Half-period in milliseconds (LED toggles every period_ms).
 * @return 0 on success, negative errno on failure.
 */
int board_led_blink_start(uint32_t period_ms);

/**
 * @brief Stop LED blinking (LED stays in its current state).
 */
void board_led_blink_stop(void);

#endif /* _USB_LED_H */
```

## include/linky.h
```c
/*
 * Copyright (c) 2025 Lucas Dietrich <ld.adecy@gmail.com>
 *
 * SPDX-License-Identifier: Apache-2.0
 */

#ifndef _LINKY_H
#define _LINKY_H

#include <stddef.h>
#include <stdint.h>

#include <zephyr/bluetooth/bluetooth.h>

#define LINKY_TIC_RAW_BUFFER_SIZE 64u

#define SC_NAME_LINKY_TIC "linky-tic-measurements"
#define SC_ID_LINKY_TIC	  0xCD1F14BDlu

#define LINKY_RECORD_FLAG_VALID BIT(0)

typedef struct {
	bt_addr_le_t addr; // Record device address
	int8_t rssi;	   // RSSI
	char raw[LINKY_TIC_RAW_BUFFER_SIZE];
	int64_t timestamp; // Time of record (uptime since boot)
	uint32_t flags;	   // Temporary flags
} linky_tic_record_t;

extern struct k_msgq linky_msgq;

bool linky_adv_data_recognize_cb(struct bt_data *data, void *user_data);

bool linky_adv_data_parse_measurements_cb(struct bt_data *data, void *user_data);

#define LINKY_RECORD_BUF_SIZE		(21u + LINKY_TIC_RAW_BUFFER_SIZE)
#define LINKY_RECORD_HEADER_VERSION 0x01

int linky_record_serialize(const linky_tic_record_t *lc, uint8_t *buf, size_t len);

#endif /* _LINKY_H */
```

## include/observer.h
```c
/*
 * Copyright (c) 2024 Lucas Dietrich <ld.adecy@gmail.com>
 *
 * SPDX-License-Identifier: Apache-2.0
 */

#ifndef _BLE_OBSERVER_H
#define _BLE_OBSERVER_H

#include <stdint.h>

#include <zephyr/bluetooth/addr.h>

typedef struct {
	int8_t rssi;		   // RSSI
	int16_t temperature;   // Device measured temperature, base unit : 1e-2 °C
	uint16_t humidity;	   /* Device measured humidity, base unit : 1e-2 % */
	uint16_t battery_mv;   // Device measured battery voltage, base unit: 1 mV
	uint8_t battery_level; // Device measured battery level, base unit:  %, valid if > 0
} xiaomi_measurements_t;

typedef struct {
	bt_addr_le_t addr;					// Record device address
	uint32_t time;						// Time of record
	xiaomi_measurements_t measurements; // Record measurements
	uint32_t valid;						// Record validity
} xiaomi_record_t;

int ble_observer_start(void);

#endif /* _BLE_OBSERVER_H */
```

## include/stream_client.h
```c
/*
 * Copyright (c) 2024 Lucas Dietrich <ld.adecy@gmail.com>
 *
 * SPDX-License-Identifier: Apache-2.0
 */

#ifndef _STREAM_CLIENT_H
#define _STREAM_CLIENT_H

#include <stddef.h>
#include <stdint.h>

#include <zephyr/kernel.h>

int stream_client_start(void);

bool stream_client_is_connected(void);

/**
 * @brief Callback invoked when the TCP stream server connection state changes.
 *
 * @param connected true when a connection is established, false on disconnect.
 */
typedef void (*stream_client_conn_cb_t)(bool connected);

void stream_client_set_conn_cb(stream_client_conn_cb_t cb);

int stream_client_channel_add(uint32_t channel_id,
							  const char *name,
							  struct k_msgq *tx_msgq,
							  struct k_msgq *rx_msgq);

int stream_try_connect(void);

#endif /* _STREAM_CLIENT_H */
```

## include/usb_net.h
```c
/*
 * Copyright (c) 2024 Lucas Dietrich <ld.adecy@gmail.com>
 *
 * SPDX-License-Identifier: Apache-2.0
 */

#ifndef _USB_NET_H
#define _USB_NET_H

void usb_net_iface_init(void);

#endif /* _USB_NET_H */
```

## include/xiaomi.h
```c
/*
 * Copyright (c) 2024 Lucas Dietrich <ld.adecy@gmail.com>
 *
 * SPDX-License-Identifier: Apache-2.0
 */

#ifndef _XIAOMI_LYWSD03MMC_H
#define _XIAOMI_LYWSD03MMC_H

#include <stddef.h>
#include <stdint.h>

#include <zephyr/bluetooth/bluetooth.h>

#define XIAOMI_MANUFACTURER_ADDR_STR "A4:C1:38:00:00:00"

typedef struct {
	int8_t rssi;		   // RSSI
	int16_t temperature;   // Device measured temperature, base unit : 1e-2 °C
	uint16_t humidity;	   /* Device measured humidity, base unit : 1e-2 % */
	uint16_t battery_mv;   // Device measured battery voltage, base unit: 1 mV
	uint8_t battery_level; // Device measured battery level, base unit:  %, valid if > 0
} xiaomi_measurements_t;

#define XIAOMI_RECORD_FLAG_VALID 0x01

typedef struct {
	bt_addr_le_t addr;					// Record device address
	xiaomi_measurements_t measurements; // Record measurements
	int64_t timestamp;					// Time of record (uptime since boot)
	uint32_t flags;						// flags
} xiaomi_record_t;

#define SC_NAME_XIAOMI	  "xiaomi-lywsd03mmc-measurements"
#define SC_ID_XIAOMI	  0xFA30FA42lu
#define SC_PL_SIZE_XIAOMI sizeof(xiaomi_measurements_t)

bool xiaomi_bt_data_parse(const bt_addr_le_t *addr,
						  int8_t rssi,
						  struct net_buf_simple *ad,
						  xiaomi_record_t *xc);

#define XIAOMI_RECORD_BUF_SIZE		 24
#define XIAOMI_RECORD_HEADER_VERSION 0x01

/* Buffer layout is as follows:
 *  - 6 bytes: BLE address
 *   - 1 byte: BLE address type
 *  - 1 byte: RSSI
 *  - 1 byte: header version
 *  - 8 bytes: timestamp
 *  - 2 bytes: temperature
 *  - 2 bytes: humidity
 *  - 2 bytes: battery voltage (mV)
 *  - 1 byte: battery level (%)
 */
int xiaomi_record_serialize(const xiaomi_record_t *xc, uint8_t *buf, size_t len);

extern struct k_msgq xiaomi_msgq;

#endif /* _XIAOMI_LYWSD03MMC_H */
```

## src/ble_observer.c
```c
/*
 * Copyright (c) 2024 Lucas Dietrich <ld.adecy@gmail.com>
 *
 * SPDX-License-Identifier: Apache-2.0
 */

#include "linky.h"
#include "zephyr/bluetooth/addr.h"

#include <stddef.h>
#include <stdio.h>

#include <zephyr/bluetooth/bluetooth.h>
#include <zephyr/bluetooth/uuid.h>
#include <zephyr/logging/log.h>

#include <ble_observer.h>
#include <stream_client.h>
#include <xiaomi.h>

LOG_MODULE_REGISTER(obv, LOG_LEVEL_INF);

static bool bt_addr_manufacturer_match(const char *mf_addr_str, const bt_addr_t *addr)
{
	bt_addr_t mf;
	bt_addr_from_str(mf_addr_str, &mf);

	return memcmp(&addr->val[3], &mf.val[3], 3U) == 0;
}

static void device_found(const bt_addr_le_t *addr,
						 int8_t rssi,
						 uint8_t type,
						 struct net_buf_simple *ad)
{
	int ret;

#if CONFIG_COPRO_XIAOMI_LYWSD03MMC
	if (bt_addr_manufacturer_match(XIAOMI_MANUFACTURER_ADDR_STR, &addr->a) == true) {
		xiaomi_record_t xc = {0};
		if (xiaomi_bt_data_parse(addr, rssi, ad, &xc) == true) {

			char buf_record[XIAOMI_RECORD_BUF_SIZE];
			ret = xiaomi_record_serialize(&xc, buf_record, XIAOMI_RECORD_BUF_SIZE);
			if (ret < 0) {
				LOG_ERR("Failed to serialize xiaomi record: %d", ret);
				return;
			}

			ret = k_msgq_put(&xiaomi_msgq, buf_record, K_NO_WAIT);
			if (ret < 0) {
				LOG_ERR("Failed to put xiaomi record in msgq: %d", ret);
			}
		}
		return;
	}
#endif

#if CONFIG_COPRO_LINKY_TIC
	bool is_linky = false;
	struct net_buf_simple_state state;
	net_buf_simple_save(ad, &state);
	bt_data_parse(ad, linky_adv_data_recognize_cb, &is_linky);
	net_buf_simple_restore(ad, &state);

	if (is_linky == true) {
		linky_tic_record_t record = {0};
		bt_addr_le_copy(&record.addr, addr);
		record.rssi		 = rssi;
		record.timestamp = k_uptime_get();

		char addr_str[BT_ADDR_STR_LEN];
		bt_addr_to_str(&addr->a, addr_str, sizeof(addr_str));
		LOG_INF("Linky found: %s (RSSI %d)", addr_str, (int)rssi);
		bt_data_parse(ad, linky_adv_data_parse_measurements_cb, (void *)&record);

		char buf_record[LINKY_RECORD_BUF_SIZE];
		ret = linky_record_serialize(&record, buf_record, sizeof(buf_record));
		if (ret < 0) {
			LOG_ERR("Failed to serialize linky record: %d", ret);
			return;
		}

		if ((record.flags & LINKY_RECORD_FLAG_VALID) != 0) {
			ret = k_msgq_put(&linky_msgq, buf_record, K_NO_WAIT);
			if (ret < 0) {
				LOG_ERR("Failed to put linky record in msgq: %d", ret);
			}
		}

		return;
	}
#endif
}

int ble_observer_start(void)
{
	struct bt_le_scan_param scan_param = {
		.type	  = BT_LE_SCAN_TYPE_PASSIVE,
		.options  = BT_LE_SCAN_OPT_NONE, /* don't filter duplicates */
		.interval = BT_GAP_SCAN_FAST_INTERVAL,
		.window	  = BT_GAP_SCAN_FAST_WINDOW,
	};

	int ret = bt_le_scan_start(&scan_param, device_found);
	if (ret) {
		LOG_ERR("Starting scanning failed (ret %d)", ret);
		return ret;
	}

	return ret;
}
```
